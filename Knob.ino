// wave maker for Arduino UNO
// check the github repo for a schematic
// https://github.com/Zohiu/WaveMachine

#include <Servo.h>
#include <FastLED.h>
#include <SPI.h>
#include <Wire.h>
#include <Adafruit_GFX.h>
#include <Adafruit_SSD1306.h>
#include "AnalogPin.h"

// OLED
#define SCREEN_WIDTH 128 // OLED display width, in pixels
#define SCREEN_HEIGHT 64 // OLED display height, in pixels

#define OLED_RESET     -1
#define SCREEN_ADDRESS 0x3C
Adafruit_SSD1306 display(SCREEN_WIDTH, SCREEN_HEIGHT, &Wire, OLED_RESET);

#define LOGO_HEIGHT   16
#define LOGO_WIDTH    16

const unsigned char zohiu_Arduino_OLED_Logo [] PROGMEM = {
  0x00, 0x00, 0x00, 0x00, 0x00, 0x00, 0x00, 0x00, 0x00, 0x00, 0x00, 0x00, 0x00, 0x00, 0x00, 0x00,
  0x00, 0x00, 0x00, 0x00, 0x00, 0x00, 0x00, 0x00, 0x00, 0x00, 0x00, 0x00, 0x00, 0x00, 0x00, 0x00,
  0x00, 0x00, 0x00, 0x00, 0x00, 0x80, 0x06, 0x00, 0x00, 0x7e, 0x00, 0xc1, 0x40, 0x00, 0x00, 0x00,
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  0x00, 0x00, 0x00, 0x00, 0x00, 0x00, 0x00, 0x00, 0x00, 0x00, 0x00, 0x00, 0x00, 0x00, 0x00, 0x00
};

const unsigned char bitmap_jio [] PROGMEM = {
  0x00, 0x00, 0x00, 0x00, 0x00, 0x00, 0x00, 0x00, 0x00, 0x00, 0x00, 0x00, 0x00, 0x00, 0x00, 0x00, 
  0x00, 0x00, 0x00, 0x00, 0x00, 0x00, 0x00, 0x00, 0x00, 0x00, 0x00, 0x00, 0x00, 0x00, 0x00, 0x00, 
  0x00, 0x00, 0x00, 0x00, 0x00, 0x00, 0x00, 0x00, 0x00, 0x00, 0x00, 0x00, 0x00, 0x00, 0x00, 0x00, 
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  0x00, 0x00, 0x00, 0x00, 0x00, 0x00, 0x00, 0x00, 0x00, 0x00, 0x00, 0x00, 0x00, 0x00, 0x00, 0x00
};

const unsigned char bitmap_nawi23 [] PROGMEM = {
  0x00, 0x00, 0x00, 0x00, 0x00, 0x00, 0x00, 0x00, 0x00, 0x00, 0x00, 0x00, 0x00, 0x00, 0x00, 0x00, 
  0x00, 0x00, 0x00, 0x00, 0x00, 0x00, 0x00, 0x00, 0x00, 0x00, 0x00, 0x00, 0x00, 0x00, 0x00, 0x00, 
  0x00, 0x00, 0x00, 0x00, 0x00, 0x00, 0x00, 0x00, 0x00, 0x00, 0x00, 0x00, 0x00, 0x00, 0x00, 0x00, 
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  0x00, 0x00, 0x00, 0x00, 0x00, 0x00, 0x00, 0x00, 0x00, 0x00, 0x00, 0x00, 0x00, 0x00, 0x00, 0x00
};

// LEDS
#define LED_PIN     9
#define NUM_LEDS    3
#define BRIGHTNESS  64
#define BRIGHTNESS_HIGHLIGHT  128
#define LED_TYPE    WS2811
#define COLOR_ORDER GRB
CRGB leds[NUM_LEDS];

// GENERAL STUFF
#define pot0_a A0
#define pot0_b A2

#define pot1_a A1
#define pot1_b A3

AnalogPin pot0_a_smooth(pot0_a);
AnalogPin pot0_b_smooth(pot0_b);
AnalogPin pot1_a_smooth(pot1_a);
AnalogPin pot1_b_smooth(pot1_b);

#define button_back 4
#define button_middle 3
#define button_forward 2

int button_back_before = 0;
int button_middle_before = 0;
int button_forward_before = 0;

int current_mode = 0;
int mode_max = 3;

int current_hue = 0;

int min_range = 25;
int max_range = 70;

float min_speed = 5;
float max_speed = 20;

int return_to_home = 0;

// Servo Manager class to controll stuff
class ServoManager {
  private:
    float sinVal;
    int impulsive_phase = 0;
    Servo servo;

  public:
    int impulsive;
    int x;
    int offset;
    int runs;
    float speed;
    int range;
    int pin;

    // attaches the servo
    void init() {
      servo.attach(pin);
      servo.write(90);
    }

    // moves the servo to initial position
    void reset() {
      x = 0;
    }

    // updates the servo position along a sine wave
    void tick() {
      x++;
      servo.write(getVal());
    }

    // outputs the next value along a sine wave according to speed and amplitude
    float getVal() {
      // set to center when middle button clicked
      if (return_to_home) {
        return 90;
      // impulsive mode
      } else if (impulsive) {
        if (impulsive_phase == 0) {
          sinVal = sin(radians((x * speed / 4) + offset));
          if (x * speed / 4 >= 260) {
            x = 0;
            impulsive_phase = !impulsive_phase;
          }
        } else {
          sinVal = sin(radians((x * speed) + offset));
          if (x * speed >= 20) {
            x = 140 / speed;
            impulsive_phase = !impulsive_phase;
          }
        }

        // change the range from (-1, 1) to (0, 1)
        sinVal = (sinVal + 1) / 2;

        // amplify and center the wave
        sinVal = (sinVal * range) + (90 - (range / 2));

        return sinVal;

        // default mode
      } else {
        sinVal = sin(radians((x * speed) + offset));

        if (x * speed >= 360) {
          x = 0;
        }

        // change the range from (-1, 1) to (0, 1)
        sinVal = (sinVal + 1) / 2;

        // amplify and center the wave
        sinVal = (sinVal * range) + (90 - (range / 2));

        return sinVal;
      }
    }
};

ServoManager wave1;
ServoManager wave2;

ServoManager disp1;
ServoManager disp2;

int bootup_complete = 0;

void setup() {
  wave1.pin = 10;
  wave1.speed = 1.54;
  wave1.range = 45;
  wave1.impulsive = 0;
  wave1.init();

  wave2.pin = 11;
  wave2.speed = 1;
  wave2.range = 90;
  wave2.impulsive = 0;
  wave2.init();

  pot0_a_smooth.setNoiseThreshold(16);
  pot0_b_smooth.setNoiseThreshold(16);
  pot1_a_smooth.setNoiseThreshold(16);
  pot1_b_smooth.setNoiseThreshold(16);

  pinMode(button_back, INPUT_PULLUP);
  pinMode(button_middle, INPUT_PULLUP);
  pinMode(button_forward, INPUT_PULLUP);

  FastLED.addLeds<WS2812, LED_PIN, RGB>(leds, NUM_LEDS);
  FastLED.setBrightness(BRIGHTNESS);

  display.begin(SSD1306_SWITCHCAPVCC, SCREEN_ADDRESS);

  display.clearDisplay();
  display.drawBitmap(0, 0, bitmap_jio, 128, 64, WHITE);
  display.display();
}

// set to 1 (true) to execute on first start
int mode_has_changed = 1;
unsigned long prevMillis = 0;
int run_timings_based = 0;

void loop() {
  if (millis() - prevMillis >= 15) {
    prevMillis = millis();
    run_timings_based = 1;
  } else {
    run_timings_based = 0;
  }
  
  // this creates the bootup animation
  if (bootup_complete < 100) {
    bootup_complete++;
    delay(30);
    
    if (run_timings_based) {
      ledBootupAnim();
    }
    return;
  } else if (bootup_complete == 100) {
    bootup_complete++;
    display.clearDisplay();
    display.drawBitmap(0, 0, bitmap_nawi23, 128, 64, WHITE);
    display.display();
    return; 
  
  } else if (bootup_complete > 100 && bootup_complete < 200) {
    bootup_complete++;
    delay(30);
    
    if (run_timings_based) {
      ledBootupAnim();
    }
    return;

  
  } else if (bootup_complete == 200) {
    bootup_complete++;
    display.clearDisplay();
    display.drawBitmap(0, 0, zohiu_Arduino_OLED_Logo, 128, 64, WHITE);
    display.display();
    return;
    
  } else if (bootup_complete > 200 && bootup_complete < 300) {
    bootup_complete++;
    delay(30);
    
    if (run_timings_based) {
      ledBootupAnim();
    }
    return;
  } else if (bootup_complete == 300) {
    bootup_complete++;
    FastLED.clear(true);
    setDisplayWave();
    return;
  }

  // everything past here only executes after bootup animation finished.

  // button_back logic
  if (!digitalRead(button_back)) {
    leds[2] = CRGB(BRIGHTNESS_HIGHLIGHT, BRIGHTNESS_HIGHLIGHT, BRIGHTNESS_HIGHLIGHT);
    // stuff to detect keydown
    if (button_back_before != !digitalRead(button_back)) {
      current_mode--;
      if (current_mode < 0) {
        current_mode = mode_max;
      }
      mode_has_changed = 1;
    }
  }

  // button_middle logic
  if (!digitalRead(button_middle)) {
    leds[1] = CRGB(BRIGHTNESS_HIGHLIGHT, BRIGHTNESS_HIGHLIGHT, BRIGHTNESS_HIGHLIGHT);
    return_to_home = 1;
  } else {
    return_to_home = 0;
  }

  // button_forward logic
  if (!digitalRead(button_forward)) {
    leds[0] = CRGB(BRIGHTNESS_HIGHLIGHT, BRIGHTNESS_HIGHLIGHT, BRIGHTNESS_HIGHLIGHT);
    // stuff to detect keydown
    if (button_forward_before != !digitalRead(button_forward)) {
      current_mode++;
      if (current_mode > mode_max) {
        current_mode = 0;
      }
      mode_has_changed = 1;
    }
  }

  FastLED.show();

  button_back_before = !digitalRead(button_back);
  button_middle_before = !digitalRead(button_middle);
  button_forward_before = !digitalRead(button_forward);

  if (run_timings_based) {
    ledRainbow();
  }

  // Mode 1:
  // The first knobs control both wave
  if (current_mode == 0) {
    wave1.impulsive = false;
    wave2.impulsive = false;

    float value_1a = float(map(pot0_a_smooth.read(), 0, 1024, min_speed * 100, max_speed * 100)) / 100;
    float value_1b = round(map(pot0_b_smooth.read(), 0, 1024, min_range, max_range));

    wave1.speed = value_1a;
    wave2.speed = value_1a;
    wave1.range = value_1b;
    wave2.range = value_1b;

    float value_2a = round(map(pot1_a_smooth.read(), 0, 1024, 0, 180));
    
    wave1.offset = 0;
    wave2.offset = value_2a;
  } 

  // Mode 2:
  // Each set of knobs controls their own wave
  else if (current_mode == 1) {
    wave1.impulsive = false;
    wave2.impulsive = false;
    wave1.offset = 0;
    wave2.offset = 0;

    float value_1a = float(map(pot0_a_smooth.read(), 0, 1024, min_speed * 100, max_speed * 100)) / 100;
    float value_1b = round(map(pot0_b_smooth.read(), 0, 1024, min_range, max_range));

    float value_2a = float(map(pot1_a_smooth.read(), 0, 1024, min_speed * 100, max_speed * 100)) / 100;
    float value_2b = round(map(pot1_b_smooth.read(), 0, 1024, min_range, max_range));

    wave1.speed = value_1a;
    wave2.speed = value_2a;
    wave1.range = value_1b;
    wave2.range = value_2b;
  } 
  
  // Mode 3:
  // Mode 1, but impulsive.
  else if (current_mode == 2) {
    wave1.impulsive = true;
    wave2.impulsive = true;

    float value_1a = float(map(pot0_a_smooth.read(), 0, 1024, min_speed * 100, max_speed * 100)) / 100;
    float value_1b = round(map(pot0_b_smooth.read(), 0, 1024, min_range, max_range));

    wave1.speed = value_1a;
    wave2.speed = value_1a;
    wave1.range = value_1b;
    wave2.range = value_1b;

    float value_2a = round(map(pot1_a_smooth.read(), 0, 1024, 0, 180));
    
    wave1.offset = 0;
    wave2.offset = value_2a;
  } 
  
  // Mode 4:
  // Mode 3, but twice
  else if (current_mode == 3) {
    wave1.impulsive = true;
    wave2.impulsive = true;
    wave1.offset = 0;
    wave2.offset = 0;

    float value_1a = float(map(pot0_a_smooth.read(), 0, 1024, min_speed * 100, max_speed * 100)) / 100;
    float value_1b = round(map(pot0_b_smooth.read(), 0, 1024, min_range, max_range));

    float value_2a = float(map(pot1_a_smooth.read(), 0, 1024, min_speed * 100, max_speed * 100)) / 100;
    float value_2b = round(map(pot1_b_smooth.read(), 0, 1024, min_range, max_range));

    wave1.speed = value_1a;
    wave2.speed = value_2a;
    wave1.range = value_1b;
    wave2.range = value_2b;
  } 

  setDisplayWave();
  setDisplayWave();

  // run the wave stuff
  if (run_timings_based) {
    wave1.tick();
    wave2.tick();
  }

  if (mode_has_changed) {
    mode_has_changed = 0;
    displayChangeMode();
  }
}

int display_i = 0;

int abefore = 0;
int bbefore = 0;

void setDisplayWave() {
  if (display_i == 0) {
    disp1.reset();
    disp1.offset = wave1.offset;

    disp2.reset();
    disp2.offset = wave2.offset;
    
    display.clearDisplay();
    redrawHUD();
  }

  disp1.speed = wave1.speed;
  disp1.range = wave1.range;
  disp1.impulsive = wave1.impulsive;

  disp2.speed = wave2.speed;
  disp2.range = wave2.range;
  disp2.impulsive = wave2.impulsive;

  display_i++;

  if (current_mode == 2 || current_mode == 3) {
    disp1.x += 4;
    disp2.x += 4;
  } else {
    disp1.x++;
    disp2.x++;
  }

  int a = map(disp1.getVal(), 90 - (max_range / 2), 90 + (max_range / 2), 16, 64);
  int b = map(disp2.getVal(), 90 - (max_range / 2), 90 + (max_range / 2), 16, 64);

  if (abefore > 0 && bbefore > 0) {
    display.drawLine(display_i, a, display_i-1, abefore, WHITE);
    display.drawLine(display_i, b, display_i-1, bbefore, WHITE);
  }

  abefore = a;
  bbefore = b;

  if (display_i == 120) {
    abefore = 0;
    bbefore = 0;
    display_i = 0;
    display.display();
  }
}

// draws the HUD
void redrawHUD() {
  display.setTextSize(1.5);
  display.setTextColor(WHITE);
  display.setCursor(0, 0);
  display.print("M");
  display.print(String(current_mode + 1));
  display.print(" - ");
  if (current_mode == 0) {
    display.println("Default");
  } else if (current_mode == 1) {
    display.println("Double");
  } else if (current_mode == 2) {
    display.println("Impulse");
  } else if (current_mode == 3) {
    display.println("Impulse Double");
  }
}

// update the display after the mode has changed
void displayChangeMode() {
  // reset the sin to start so it restarts sine wave drawing
  display_i = 0;

  wave1.reset();
  wave2.reset();

  disp1.reset();
  disp2.reset();

  // draws the whole sine wave (and HUD)
  for (int i = 0; i <= 120; i++) {
    setDisplayWave();
  }
}

void ledRainbowSingle(int mode) {
  current_hue++;
  leds[2 - mode] = CHSV(current_hue, 255, 255);
  FastLED.show();
}

uint8_t hue = 0;

void ledBootupAnim() {
  hue += 2;

  for (int i = 0; i < NUM_LEDS; ++i) {
    leds[i] = CHSV(hue + (i * 25), 255, map(bootup_complete, 0, 300, 0, BRIGHTNESS));
  }
  FastLED.show();
}

void ledRainbow() {
  hue++;

  for (int i = 0; i < NUM_LEDS; ++i) {
    leds[i] = CHSV(hue + (i * 25), 255, BRIGHTNESS);
  }
}
